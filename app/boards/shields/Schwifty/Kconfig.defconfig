## app/boards/shields/Schwifty/Kconfig.defconfig
```kconfig
# Copyright (c) 2020 The ZMK Contributors
# SPDX-License-Identifier: MIT

if SHIELD_SCHWIFTY

config ZMK_KEYBOARD_NAME
	default "Schwifty"

endif
```

## app/boards/shields/Schwifty/Kconfig.shield
```kconfig
# Copyright (c) 2020 The ZMK Contributors
# SPDX-License-Identifier: MIT

config SHIELD_SCHWIFTY
   def_bool $(shields_list_contains,schwifty)
```

## app/boards/shields/contra/Kconfig.defconfig
```kconfig
# Copyright (c) 2020 The ZMK Contributors
# SPDX-License-Identifier: MIT

if SHIELD_contra

config ZMK_KEYBOARD_NAME
	default "contra"

endif
```

## app/boards/shields/nugget/Kconfig.defconfig
```kconfig
# Copyright (c) 2020 The ZMK Contributors
# SPDX-License-Identifier: MIT

if SHIELD_NUGGET

config ZMK_KEYBOARD_NAME
	default "nugget"

endif
```

## app/boards/shields/nugget/Kconfig.shield
```kconfig
# Copyright (c) 2020 The ZMK Contributors
# SPDX-License-Identifier: MIT

config SHIELD_NUGGET
   def_bool $(shields_list_contains,nugget)
```
